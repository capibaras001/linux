## Documentation/devicetree/bindings/display/panel/himax,hx8874.yaml
```yaml
# SPDX-License-Identifier: GPL-2.0-only OR BSD-2-Clause
%YAML 1.2
---
$id: http://devicetree.org/schemas/display/panel/himax,hx8874.yaml#
$schema: http://devicetree.org/meta-schemas/core.yaml#

title: Himax HX8874 dual-DSI DSC command-mode OLED panel

maintainers:
  - np05j port <np05j@localhost>

description:
  The Himax HX8874 is a 9.06" 2400x1504 OLED panel driven over two MIPI DSI
  links (4 lanes each). The image is split across the two links (1200x1504
  per link) and the stream is VESA DSC 1.1 compressed. The panel operates in
  command mode. It is used on the Nubia/ZTE np05j (RedMagic Tablet 3 Pro,
  SM8750).

allOf:
  - $ref: panel-common-dual.yaml#

properties:
  compatible:
    const: himax,hx8874

  reg:
    maxItems: 1

  reset-gpios:
    maxItems: 1
    description: phandle of the gpio for the active-low reset line

  vddio-supply:
    description: regulator that supplies the panel power/IO voltage

  ports:
    properties:
      port@1: true
    required:
      - port@1

  backlight: true
  rotation: true

required:
  - compatible
  - reg
  - reset-gpios
  - vddio-supply
  - ports

unevaluatedProperties: false

examples:
  - |
    #include <dt-bindings/gpio/gpio.h>

    dsi {
        #address-cells = <1>;
        #size-cells = <0>;

        panel@0 {
            compatible = "himax,hx8874";
            reg = <0>;

            vddio-supply = <&vreg_panel>;
            reset-gpios = <&tlmm 98 GPIO_ACTIVE_LOW>;
            backlight = <&backlight>;

            ports {
                #address-cells = <1>;
                #size-cells = <0>;

                port@0 {
                    reg = <0>;
                    panel_in_0: endpoint {
                        remote-endpoint = <&dsi0_out>;
                    };
                };

                port@1 {
                    reg = <1>;
                    panel_in_1: endpoint {
                        remote-endpoint = <&dsi1_out>;
                    };
                };
            };
        };
    };

...
```
